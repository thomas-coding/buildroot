## configs/a55_defconfig
```kconfig
# Architecture
BR2_aarch64=y

# System
BR2_TARGET_GENERIC_GETTY_PORT="ttyS0"

# Toolchain
BR2_TOOLCHAIN=y
BR2_TOOLCHAIN_USES_GLIBC=y
BR2_TOOLCHAIN_EXTERNAL=y

# Toolchain External Options
BR2_TOOLCHAIN_EXTERNAL_CUSTOM=y
BR2_TOOLCHAIN_EXTERNAL_HEADERS_4_20=y
BR2_TOOLCHAIN_EXTERNAL_CUSTOM_GLIBC=y
BR2_TOOLCHAIN_EXTERNAL_INET_RPC=n
BR2_TOOLCHAIN_EXTERNAL_CUSTOM_PREFIX="aarch64-none-linux-gnu"

# Add cpio
BR2_TARGET_ROOTFS_CPIO=y
#BR2_TARGET_ROOTFS_CPIO_GZIP=y

# Add for dmsetup
BR2_PACKAGE_LVM2=y

# Add for kdump
BR2_PACKAGE_KEXEC=y

# Add gdb
BR2_TOOLCHAIN_EXTERNAL_CXX=y
BR2_ENABLE_DEBUG=y
BR2_PACKAGE_GDB=y
BR2_PACKAGE_HOST_GDB=y
BR2_INSTALL_LIBSTDCPP=y
BR2_PACKAGE_GDB_DEBUGGER=y
BR2_PACKAGE_GDB_TUI=y
BR2_PACKAGE_GDB_PYTHON=y
BR2_TOOLCHAIN_EXTERNAL_GDB_SERVER_COPY=y

# Add compile tools
BR2_PACKAGE_MAKE=y

# Add fs tools
BR2_PACKAGE_EXFAT=y
BR2_PACKAGE_EXFAT_UTILS=y
BR2_PACKAGE_F2FS_TOOLS=y
BR2_PACKAGE_GENEXT2FS=y
BR2_PACKAGE_GENPART=y
BR2_PACKAGE_GENROMFS=y
BR2_PACKAGE_AUTOFS=y
BR2_PACKAGE_DOSFSTOOLS=y
BR2_PACKAGE_DOSFSTOOLS_FATLABEL=y
BR2_PACKAGE_DOSFSTOOLS_FSCK_FAT=y
BR2_PACKAGE_DOSFSTOOLS_MKFS_FAT=y
BR2_PACKAGE_EXFATPROGS=y

# Add for net dhcp
BR2_SYSTEM_DHCP="eth0"

# Add ssh
# After power on, set /etc/ssh/sshd_config PermitRootLogin yes, then reboot
# ssh root@localhost -p 3522
# scp -P 3522 build.sh root@localhost:/root/
BR2_PACKAGE_OPENSSL=y
BR2_PACKAGE_OPENSSH=y
BR2_PACKAGE_OPENSSH_CLIENT=y
BR2_PACKAGE_OPENSSH_SERVER=y
BR2_PACKAGE_HOST_MKPASSWD=y
BR2_TARGET_GENERIC_ROOT_PASSWD="root"

# Add libkcapi
BR2_PACKAGE_LIBKCAPI=y
BR2_PACKAGE_LIBKCAPI_TEST=y
BR2_PACKAGE_LIBKCAPI_DGSTAPP=y
BR2_PACKAGE_LIBKCAPI_ASYM=y
BR2_PACKAGE_LIBKCAPI_ENCAPP=y
BR2_PACKAGE_LIBKCAPI_HASHER=y
BR2_PACKAGE_LIBKCAPI_KPP=y
BR2_PACKAGE_LIBKCAPI_RNGAPP=y
BR2_PACKAGE_LIBKCAPI_SPEED=y

# Add bash for shell script
BR2_PACKAGE_BUSYBOX_SHOW_OTHERS=y
BR2_PACKAGE_BASH=y
BR2_SYSTEM_BIN_SH_BASH=y
```

## configs/thomas_riscv64_defconfig
```kconfig
# Architecture
BR2_riscv=y

# System
BR2_TARGET_GENERIC_GETTY_PORT="ttyS0"

# Toolchain
BR2_TOOLCHAIN=y
BR2_TOOLCHAIN_USES_GLIBC=y
BR2_TOOLCHAIN_EXTERNAL=y

# Toolchain External Options
BR2_TOOLCHAIN_EXTERNAL_CUSTOM=y
BR2_TOOLCHAIN_EXTERNAL_PATH=""
BR2_TOOLCHAIN_EXTERNAL_CUSTOM_PREFIX="riscv64-unknown-linux-gnu"
BR2_TOOLCHAIN_EXTERNAL_HEADERS_6_6=y
BR2_TOOLCHAIN_EXTERNAL_GCC_13=y
BR2_TOOLCHAIN_EXTERNAL_CUSTOM_GLIBC=y
BR2_TOOLCHAIN_EXTERNAL_INET_RPC=n
BR2_TOOLCHAIN_EXTERNAL_CXX=y
BR2_TOOLCHAIN_EXTERNAL_FORTRAN=y
BR2_TOOLCHAIN_EXTERNAL_OPENMP=y

# Add cpio
BR2_TARGET_ROOTFS_CPIO=y
BR2_TARGET_ROOTFS_CPIO_GZIP=y
BR2_TARGET_ROOTFS_EXT2=y
BR2_TARGET_ROOTFS_EXT2_SIZE="1024M"
```
